## esp_ble_com/main/Kconfig.projbuild
```kconfig
menu "COM Configuration"

    menu "GPIO Setting"
    config COM_GPIO_BOOT
        int "GPIO pin for the BOOT signal"
        default 2

    config COM_GPIO_RST
        int "GPIO pin for the RESET signal"
        default 10

    config COM_GPIO_RXD
        int "GPIO pin for the RxD signal"
        default 4

    config COM_GPIO_TXD
        int "GPIO pin for the TxD signal"
        default 3
    endmenu
endmenu
```
